## Documentation/devicetree/bindings/arm/ipq.txt
```
QCA IPQ device tree bindings
------------------------------

System on Chip

Device tree must specify which SoC it uses, with one of the following
compatible strings

	"qcom,ipq807x"
Platform

Device tree must specify which Platform it uses, with one of the following
compatible strings
	"qcom,ipq807x-hk01"
```

## Documentation/devicetree/bindings/mtd/qcom_nandc.txt
```
* Qualcomm NAND controller

Required properties:
- compatible:		should be "qcom,ebi2-nand" for IPQ806x. You'll also need
			a compatible string for u-boots which populate the
			devicetree with flash partitions, such as
			"qcom,qcom_nand".
- reg:			MMIO address range
- clocks:		must contain core clock and always on clock
- clock-names:		must contain "core" for the core clock and "aon" for the
			always on clock
- dmas:			DMA specifier, consisting of a phandle to the ADM DMA
			controller node and the channel number to be used for
			NAND. Refer to dma.txt and qcom_adm.txt for more details
- dma-names:		must be "rxtx"
- qcom,cmd-crci:	must contain the ADM command type CRCI block instance
			number specified for the NAND controller on the given
			platform
- qcom,data-crci:	must contain the ADM data type CRCI block instance
			number specified for the NAND controller on the given
			platform

Optional properties:
- nand-bus-width:	bus width. Must be 8 or 16. If not present, 8 is chosen
			as default

- nand-ecc-strength:	number of bits to correct per ECC step. Must be 4 or 8
			bits. If not present, 4 is chosen as default
- nand-on-flash-bbt:	Create/use on-flash bad block table

The device tree may optionally contain sub-nodes describing partitions of the
address space. See partition.txt for more detail.

Example:

nand@1ac00000 {
	compatible = "qcom,ebi2-nandc","qcom.qcom_nand";
	reg = <0x1ac00000 0x800>;

	clocks = <&gcc EBI2_CLK>,
		 <&gcc EBI2_AON_CLK>;
	clock-names = "core", "aon";

	dmas = <&adm_dma 3>;
	dma-names = "rxtx";
	qcom,cmd-crci = <15>;
	qcom,data-crci = <3>;

	partition@0 {
	...
	};
};
```

## Documentation/devicetree/bindings/net/qcom-nss-dp.txt
```
* Qualcomm Technologies Inc. NSS Data Plane Platform Driver.

Master data plane driver for the QCA networking subsystem (NSS)

Required properties:
- device_type: = "network";
- compatible: = should be "qcom,nss-dp";
- qcom,id: Unique Identifier for the GMAC block. This field is unique identifier
		for each physical port.
- reg: Base address and size for the Qcom/Synopsys Mac Register space
- qcom,mactype: = 0 for Qcom GMAC, 1 for Synopsys GMAC.
- local-mac-address: MAC Address to be used at the time of interface
			initialization

Example:

dp1 {
	device_type = "network";
	compatible = "qcom,nss-dp";
	qcom,id = <1>;
	reg = <0x3a001000 0x200>;
	qcom,mactype = <0>;
	local-mac-address = [000000000000];
};
```

## Documentation/devicetree/bindings/net/qcom-ssdk.txt
```
* Qualcomm Technologies Inc. SSDK Driver.


Required properties:
- compatible: = should be "qcom,ess-switch";
- reg: Base address and size for the ess-switch register space
- switch_access_mode: should be "local bus"

Example:

ess-switch@3a000000 {
	compatible = "qcom,ess-switch";
	reg = <0x3a000000 0x1000000>;
	switch_access_mode = "local bus";
};
```

## Documentation/devicetree/bindings/nvmem/microchip-otpc.yaml
```yaml
# SPDX-License-Identifier: (GPL-2.0 OR BSD-2-Clause)
%YAML 1.2
---
$id: http://devicetree.org/schemas/nvmem/microchip-otpc.yaml#
$schema: http://devicetree.org/meta-schemas/core.yaml#

title: Microchip SAMA7G5 OTP Controller (OTPC) device tree bindings

maintainers:
  - Claudiu Beznea <claudiu.beznea@microchip.com>

description: |
  This binding represents the OTP controller found on SAMA7G5 SoC.

allOf:
  - $ref: "nvmem.yaml#"

properties:
  compatible:
    items:
      - const: microchip,sama7g5-otpc
      - const: syscon

  reg:
    maxItems: 1

  "#address-cells":
    const: 1

  "#size-cells":
    const: 1

  clocks:
    maxItems: 1

required:
  - "#address-cells"
  - "#size-cells"
  - compatible
  - reg

patternProperties:
  "^.*@[0-9a-f]+$":
    type: object

    properties:
      reg:
        maxItems: 1
        description:
          Offset and size in bytes within the storage device.

    required:
      - reg

    additionalProperties: false

unevaluatedProperties: false

examples:
  - |
    #include <dt-bindings/clock/at91.h>

    otpc: efuse@e8c00000 {
        compatible = "microchip,sama7g5-otpc", "syscon";
        reg = <0xe8c00000 0x100>;
        #address-cells = <1>;
        #size-cells = <1>;

        temperature_calib: calib@0 {
            reg = <0x0 0x2c>;
        };
    };

...
```

## Documentation/devicetree/bindings/remoteproc/q6v5-wcss-rproc.txt
```
QCA Wakeup Q6-WCSS Remoteproc Driver
=====================================

The IPQ807x family of devices uses a Q6-WCSS DSP co-processor. The Q6-WCSS
requires a firmware binary to boot. The q6-wcss remoteproc driver handles
the loading of firmware and booting of q6-wcss.

Q6v5 WCSS Device Node:
======================
A q6v5-wcss device node is used to represent the Q6-WCSS processor
instance within the SoC. It is needed as child node to SOC parent node
through which it is accessible to the IPQ807x.

Required properties:
--------------------
- compatible:		Should be one of,
				"qcom,q6v5-wcss-rproc" for IPQ807x SoCs
- reg:			Should contain the address ranges for the Q6-WCSS
			internal memory regions, QDSP6SS_PUB. The parent node
			should provide an appropriate range property for
			properly translating these into bus addresses.
- firmware:		Name of firmware file to be used for loading and
			booting the q6-wcss remote processor.

Example:
--------
/* IPQ807x */
soc {
	q6v5_wcss@0x0AD00000 {
		compatible = "qcom,rproc-q6v5-wcss";
		firmware = "q6-wcss-boot";
		reg = <0xC900000 0x4040>;
	};
	...
};
```

## Documentation/devicetree/bindings/soc/microchip/microchip,miv-rpmsg.yaml
```yaml
# SPDX-License-Identifier: (GPL-2.0-only OR BSD-2-Clause)
%YAML 1.2
---
$id: "http://devicetree.org/schemas/soc/microchip/microchip,miv-rpmsg.yaml#"
$schema: "http://devicetree.org/meta-schemas/core.yaml#"

title: Microchip Mi-V RPMsg platform driver

maintainers:
  - Valentina Fernandez <valentina.fernandezalanis@microchip.com>
  - Conor Dooley <conor.dooley@microchip.com>

properties:
  compatible:
    const: microchip,miv-rpmsg

  reg:
    items:
      - description: memory region reserved for the rpmsg vrings

  mboxes:
    description:
      Mi-V IHC mailbox specifier. To be used for communication with a
      remote AMP context. The specifier format is as per the bindings,
      Documentation/devicetree/bindings/mailbox/microchip,miv-ihc.yaml
    maxItems: 1

  memory-region:
    description:
      A phandle for a reserved memory area used for the rpmsg vring
      DMA buffers. The reserved memory region should be defined with a
      "shared-dma-pool" property as per the bindings defined in
      Documentation/devicetree/bindings/reserved-memory/reserved-memory.txt
    maxItems: 1

required:
  - compatible
  - reg
  - mboxes
  - memory-region

additionalProperties: false

examples:
  - |

    reserved-memory {
        #address-cells = <2>;
        #size-cells = <2>;

        rpmsg_vrings@1075FB0000 {
            reg = <0x10 0x75FB0000 0x0 0x10000>;
        };

        rpmsg_vring_buffers@a2410000 {
            compatible = "shared-dma-pool";
            reg = <0x0 0xa2410000 0x0 0x40000>;
            label = "rpmsg-ddr";
        };
    };

    soc {
      #address-cells = <2>;
      #size-cells = <2>;

      rpmsg@a2400000 {
          compatible = "microchip,miv-rpmsg";
          reg =  <0x0 0xa2400000 0x0 0x10000>;
          memory-region = <&rpmsg_dma_reserved>;
          mboxes= <&ihc 0>;
      };
    };

...
```

## Documentation/devicetree/bindings/watchdog/qcom-wdt.txt
```
Qualcomm Krait Processor Sub-system (KPSS) Watchdog
---------------------------------------------------

Required properties :
- compatible : shall contain only one of the following:

			"qcom,kpss-wdt-msm8960"
			"qcom,kpss-wdt-apq8064"
			"qcom,kpss-wdt-ipq8064"
			"qcom,kpss-wdt-ipq807x"
			"qcom,kpss-wdt-ipq40xx"

- reg : shall contain base register location and length
- clocks : shall contain the input clock

Optional properties :
- timeout-sec : shall contain the default watchdog timeout in seconds,
                if unset, the default timeout is 30 seconds
- interrupts : shall contain the interrupt number

Example:
	watchdog@208a038 {
		compatible = "qcom,kpss-wdt-ipq8064", "qcom,kpss-wdt-ipq807x", "qcom,kpss-wdt-ipq40xx";
		reg = <0x0208a038 0x40>;
		clocks = <&sleep_clk>;
		timeout-sec = <10>;
		interrupts = <0 3 0>;
	};
```

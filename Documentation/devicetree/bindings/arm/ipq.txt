## drivers/media/platform/microchip/Kconfig
```kconfig
# SPDX-License-Identifier: GPL-2.0
config VIDEO_MCHP_DSCMI
	tristate "Microchip Digital Serial Camera Memory Interface Driver"
	depends on V4L_PLATFORM_DRIVERS
	depends on VIDEO_DEV && OF
	select VIDEOBUF2_DMA_CONTIG
	select MEDIA_CONTROLLER
	select VIDEO_V4L2_SUBDEV_API
	select V4L2_FWNODE
	help
	  Microchip Digital Serial Camera Memory Interface Driver Support For Smart Embedded Vision Kit.

config VIDEO_MICROCHIP_COMMON
	tristate
	default n
	help
	  Microchip common code base for FPAG Soft IP drivers.

config VIDEO_MICROCHIP_GVPC
	tristate "Microchip GVPC (Generic Video Pipeline Connector) Driver"
	depends on VIDEO_DEV && OF
	select CONFIG_VIDEO_V4L2_SUBDEV_API
	select V4L2_FWNODE
	select VIDEO_MICROCHIP_COMMON
	help
	  Microchip GVPC (Generic Video Pipeline Connector) Driver Support.

config VIDEO_MICROCHIP_MIPI_CSI2
	tristate "Microchip MIPI CSI2 Driver"
	depends on VIDEO_DEV && OF
	select CONFIG_VIDEO_V4L2_SUBDEV_API
	select V4L2_FWNODE
	select VIDEO_MICROCHIP_COMMON
	help
	  Microchip MIPI CSI2 FPGA Soft IP Driver Support.

config VIDEO_MICROCHIP_RGB_SCALER
        tristate "Microchip Video RGB Scaler"
	depends on VIDEO_DEV && OF
	select CONFIG_VIDEO_V4L2_SUBDEV_API
	select V4L2_FWNODE
	select VIDEO_MICROCHIP_COMMON
        help
          Driver for the Microchip Video RGB Scaler

config VIDEO_MICROCHIP_VIDEO_CAPTURE
	tristate "Microchip Video Capture Driver"
	depends on VIDEO_DEV && OF
	select CONFIG_VIDEO_V4L2_SUBDEV_API
	select VIDEOBUF2_DMA_CONTIG
	select V4L2_FWNODE
	select VIDEO_MICROCHIP_COMMON
	help
	  Microchip Video Capture Driver Support For FPGA Soft IP.

config VIDEO_MICROCHIP_YUV2H264
	tristate "Microchip Video H264 Encoder Driver"
	depends on VIDEO_DEV && OF
	select CONFIG_VIDEO_V4L2_SUBDEV_API
	select V4L2_FWNODE
	select VIDEO_MICROCHIP_COMMON
	help
	  Microchip Video H264 Encoder Driver Support.
```

## drivers/nxr/Kconfig
```kconfig
#
# Kconfig options for NXR
#

menu "NXR options"

config NXR
	boolean

config NXR_SFP
	bool "NXR SFP/SFP+ driver support"
	depends on KUMQUAT
	---help---
	  Say Y to NXR SFP/SFP+ driver support.

endmenu
```

## drivers/soc/qcom/Kconfig
```kconfig
#
# QCOM Soc drivers
#
config QCOM_GSBI
        tristate "QCOM General Serial Bus Interface"
        depends on ARCH_QCOM
        select MFD_SYSCON
        help
          Say y here to enable GSBI support.  The GSBI provides control
          functions for connecting the underlying serial UART, SPI, and I2C
          devices to the output pins.

config QCOM_PM
	bool "Qualcomm Power Management"
	depends on ARCH_QCOM && !ARM64
	select QCOM_SCM
	help
	  QCOM Platform specific power driver to manage cores and L2 low power
	  modes. It interface with various system drivers to put the cores in
	  low power modes.

config QCOM_SMEM
	tristate "Qualcomm Shared Memory Manager (SMEM)"
	depends on ARCH_QCOM
	depends on HWSPINLOCK
	help
	  Say y here to enable support for the Qualcomm Shared Memory Manager.
	  The driver provides an interface to items in a heap shared among all
	  processors in a Qualcomm platform.

config QCOM_SMD
	tristate "Qualcomm Shared Memory Driver (SMD)"
	depends on QCOM_SMEM
	help
	  Say y here to enable support for the Qualcomm Shared Memory Driver
	  providing communication channels to remote processors in Qualcomm
	  platforms.

config QCOM_SMD_RPM
	tristate "Qualcomm Resource Power Manager (RPM) over SMD"
	depends on QCOM_SMD && OF
	help
	  If you say yes to this option, support will be included for the
	  Resource Power Manager system found in the Qualcomm 8974 based
	  devices.

	  This is required to access many regulators, clocks and bus
	  frequencies controlled by the RPM on these devices.

	  Say M here if you want to include support for the Qualcomm RPM as a
	  module. This will build a module called "qcom-smd-rpm".

config MSM_GLINK
	bool "Generic Link (G-Link)"
	help
	 G-Link is a generic link transport that replaces SMD.  It is used
	 within a System-on-Chip (SoC) for communication between both internal
	 processors and external peripherals.  The actual physical transport
	 is handled by transport plug-ins that can be individually enabled and
	 configured separately.

config MSM_GLINK_LOOPBACK_SERVER
	bool "Generic Link (G-Link) Loopback Server"
	help
	 G-Link Loopback Server that enable loopback test framework to test
	 and validate the G-Link protocol stack. It support both local and
	 remote clients to configure the loopback server and echo back the
	 data received from the clients.

config MSM_GLINK_SMEM_NATIVE_XPRT
	depends on MSM_SMEM
	depends on MSM_GLINK
	bool "Generic Link (G-Link) SMEM Native Transport"
	help
	 G-Link SMEM Native Transport is a G-Link Transport plug-in.  It allows
	 G-Link communication to remote entities through a shared memory
	 physical transport.  The nature of shared memory limits this G-Link
	 transport to only connecting with entities internal to the
	 System-on-Chip.

config MSM_GLINK_PKT
	bool "Enable device interface for GLINK packet channels"
	depends on MSM_GLINK
	help
	 G-link packet driver provides the interface for the userspace
	 clients to communicate over G-Link via device nodes.
	 This enable the usersapce clients to read and write to
	 some glink packets channel.

config MSM_IPC_ROUTER_GLINK_XPRT
	depends on MSM_GLINK
	depends on IPC_ROUTER
	bool "MSM GLINK XPRT Layer"
	help
	 GLINK Transport Layer that enables IPC Router communication within
	 a System-on-Chip(SoC). When the GLINK channels become available,
	 this layer registers a transport with IPC Router and enable
	 message exchange.

config MSM_SMEM
	depends on ARCH_QCOM
	depends on HWSPINLOCK_QCOM
	bool "MSM Shared Memory (SMEM)"
	help
	 Support for the shared memory interface between the various
	 processors in the System on a Chip (SoC) which allows basic
	 inter-processor communication.
```

## drivers/usb/misc/bt_ifusb/Kconfig
```kconfig
# SPDX-License-Identifier: GPL-2.0

menu "bt_ifusb device drivers"

config BT_IFUSB
	tristate "BLUETOOTH USB driver"
	default m
	help
	  bt_ifusb driver.
	  This driver is required if you want to use Bluetooth devices with
	  USB interface.

	  Say Y here to compile support for Bluetooth USB devices into the
	  kernel or say M to compile it as module (bt_ifusb).

endmenu
```

## sound/soc/qcom/Kconfig
```kconfig
config SND_SOC_QCOM
	tristate "ASoC support for QCOM platforms"
	depends on ARCH_QCOM || COMPILE_TEST
	help
          Say Y or M if you want to add support to use audio devices
          in Qualcomm Technologies SOC-based platforms.

config SND_SOC_LPASS_CPU
	tristate
	select REGMAP_MMIO

config SND_SOC_LPASS_PLATFORM
	tristate
	select REGMAP_MMIO

config SND_SOC_LPASS_IPQ806X
	tristate
	select SND_SOC_LPASS_CPU
	select SND_SOC_LPASS_PLATFORM

config SND_SOC_LPASS_APQ8016
	tristate
	select SND_SOC_LPASS_CPU
	select SND_SOC_LPASS_PLATFORM

config SND_SOC_STORM
	tristate "ASoC I2S support for Storm boards"
	depends on SND_SOC_QCOM
	select SND_SOC_LPASS_IPQ806X
	select SND_SOC_MAX98357A
	help
          Say Y or M if you want add support for SoC audio on the
          Qualcomm Technologies IPQ806X-based Storm board.

config SND_SOC_APQ8016_SBC
	tristate "SoC Audio support for APQ8016 SBC platforms"
	depends on SND_SOC_QCOM
	select SND_SOC_LPASS_APQ8016
	help
          Support for Qualcomm Technologies LPASS audio block in
          APQ8016 SOC-based systems.
          Say Y if you want to use audio devices on MI2S.

config SND_SOC_IPQ4019
	tristate "Soc Audio support for IPQ4019 platforms"
	depends on SND_SOC_QCOM && HAS_DMA
	select SND_SOC_IPQ4019_ADSS
	select SND_SOC_IPQ4019_CPU_DAI
	select SND_SOC_IPQ4019_STEREO
	select SND_SOC_IPQ4019_MBOX
	select SND_SOC_IPQ4019_PCM_I2S
	select SND_SOC_IPQ4019_CODEC
	select SND_SOC_IPQ4019_PCM_TDM
	select SND_SOC_IPQ4019_PCM_SPDIF
	help
	Say Y or M to if you want to add support for SoC audio on
	Qualcomm Atheros IPQ4019 based board.

config SND_SOC_IPQ4019_ADSS
	tristate
	depends on SND_SOC_IPQ4019

config SND_SOC_IPQ4019_CPU_DAI
	tristate
	depends on SND_SOC_IPQ4019

config SND_SOC_IPQ4019_STEREO
	tristate
	depends on SND_SOC_IPQ4019

config SND_SOC_IPQ4019_MBOX
	tristate
	depends on SND_SOC_IPQ4019

config SND_SOC_IPQ4019_PCM_I2S
	tristate
	depends on SND_SOC_IPQ4019

config SND_SOC_IPQ4019_CODEC
	tristate
	depends on SND_SOC_IPQ4019

config SND_SOC_IPQ4019_PCM_TDM
	tristate
	depends on SND_SOC_IPQ4019

config SND_SOC_IPQ4019_PCM_SPDIF
	tristate
	depends on SND_SOC_IPQ4019
```

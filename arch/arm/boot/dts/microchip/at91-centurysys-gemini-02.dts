// SPDX-License-Identifier: (GPL-2.0+ OR MIT)
/*
 * at91-centurysys-gemini-02.dts - Device Tree file for Century Systems Gemini board
 *
 * Copyright (C) 2023-2026 Century Systems
 */
/dts-v1/;
#include "at91-centurysys-gemini-common.dtsi"

/ {
	model = "Century Systems Gemini";
	compatible = "atmel,sama5d2-gemini", "atmel,sama5d2", "atmel,sama5";
};
